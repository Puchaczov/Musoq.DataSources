VERSION ""

NS_ :

BS_:

BU_:

BO_ 293 Exhaust_System: 1 Vector__XXX
 SG_ Exhaust_Gas_Temperature : 0|8@1+ (1,0) [0|255] "CelciusDegree" Vector__XXX

BO_ 292 Engine: 2 Vector__XXX
 SG_ Oil_Temperature : 2|8@1- (1,0) [-50|100] "CelciusDegree" Vector__XXX
 SG_ Is_Turned_On : 0|1@1+ (1,0) [0|1] "" Vector__XXX

BO_ 444 Driving: 8 Vector__XXX
 SG_ Vehicle_Speed : 28|16@1+ (0.01,0) [0|655.35] "km/h"  Vector__XXX

BA_DEF_  "BusType" STRING ;
BA_DEF_DEF_  "BusType" "CAN";
